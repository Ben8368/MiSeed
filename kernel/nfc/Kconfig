## kernel/nfc/Kconfig
```kconfig
# SPDX-License-Identifier: GPL-2.0-only
config NFC_SN100X
	tristate "NXP SN100T NCI I2C transport"
	depends on I2C && NFC_NCI && GPIOLIB
	help
	  Standard Linux NFC/NCI transport for NXP SN100T. Uses resident
	  firmware and retains shared NFCC/eSE VEN on close. Firmware download,
	  eSE access and active NFC suspend/wakeup are not supported.
	  If built as a module, this driver is called sn100x.

config MISEED_RX_NFC_COEX
	bool "Umi experimental wireless RX and NFC coexistence"
	depends on NFC_SN100X=y && MISEED_RX_DIAGNOSTIC
	help
	  Exercise the local NCI RF inhibit extension during RX diagnostics.
```

## kernel/power/Kconfig
```kconfig
# SPDX-License-Identifier: GPL-2.0-only
# Umi runtime integration. SMB5 follows the LOS policy after telemetry checks.
config BATTERY_MISEED_QCOM_FG
	tristate "MiSeed Qualcomm FG port (Umi runtime)"
	depends on SPMI && POWER_SUPPLY && OF
	help
	  Qualcomm FG driver from colorgarden/umi-mainline. Gen4 telemetry
	  are read from inherited peripheral state; no profile SRAM is loaded.

config CHARGER_MISEED_PM8150B
	tristate "MiSeed PM8150B charger port (Umi runtime)"
	depends on SPMI && POWER_SUPPLY && IIO && OF
	depends on THERMAL && THERMAL_OF
	help
	  SMB5 driver from colorgarden/umi-mainline with the fixed LOS Umi
	  current/voltage profile and automatic attach policy. Userspace controls
	  charging through the standard power_supply properties.

config CHARGER_BQ25970_CORE
	tristate "Texas Instruments BQ25970 charge pump"
	depends on I2C && OF && POWER_SUPPLY
	select REGMAP_I2C
	help
	  Independent chip transport, IRQ, fault cache and power_supply.
	  Starts disabled. Generic DT devices expose monitoring only; active
	  charging requires a qualified board adapter and exclusive owner.

config CHARGER_MISEED_UMI_PPS
	bool "MiSeed Umi guarded BQ25970 PPS controller"
	depends on I2C=y && OF && TYPEC_TCPM && TYPEC_QCOM_PMIC
	depends on THERMAL && THERMAL_OF
	depends on CHARGER_MISEED_PM8150B && BATTERY_MISEED_QCOM_FG
	select AUXILIARY_BUS
	select CHARGER_BQ25970_CORE
	help
	  Automatic LOS-style PPS policy using mainline TCPM and a standalone
	  BQ25970. The Umi board profile is sink-only and is exercised on the
	  maintainer's Umi device through temporary RAM boot.

config MISEED_POWER_DIAGNOSTICS
	bool "MiSeed read-only wired SMB5 register diagnostics"
	depends on CHARGER_MISEED_PM8150B
	help
	  Log raw status registers from the owning charger's polling worker.
	  This is an optional diagnostic, not a product ABI or control path.
	  Normal consumers use power_supply attributes and notifications.
```
