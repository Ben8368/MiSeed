## kernel/display/Kconfig
```kconfig
# SPDX-License-Identifier: GPL-2.0-only
config DRM_PANEL_XIAOMI_UMI_CSOT
	tristate "Xiaomi Umi CSOT command-mode DSC panel"
	depends on OF && DRM_MIPI_DSI && BACKLIGHT_CLASS_DEVICE
	select DRM_DISPLAY_DSC_HELPER
	help
	  Fixed CSOT j2_mp_42_02_0b data, standard DRM panel and backlight.
	  Other Umi panel variants are not supported by this driver.
```

## kernel/nfc/Kconfig
```kconfig
# SPDX-License-Identifier: GPL-2.0-only
config NFC_SN100X
	tristate "NXP SN100T NCI I2C transport"
	depends on I2C && NFC_NCI && GPIOLIB
	help
	  Standard Linux NFC/NCI transport for NXP SN100T. Uses resident
	  firmware and retains shared NFCC/eSE VEN on close. Firmware download,
	  eSE access and active NFC suspend/wakeup are not supported.
	  If built as a module, this driver is called sn100x.
```

## kernel/power/Kconfig
```kconfig
# SPDX-License-Identifier: GPL-2.0-only
# Umi runtime integration. SMB5 follows the LOS policy after telemetry checks.
config BATTERY_MISEED_QCOM_FG
	tristate "MiSeed Qualcomm FG port (Umi runtime)"
	depends on SPMI && POWER_SUPPLY && OF
	help
	  Qualcomm FG driver from colorgarden/umi-mainline. Gen4 telemetry
	  are read from inherited peripheral state; no profile SRAM is loaded.

config CHARGER_MISEED_PM8150B
	tristate "MiSeed PM8150B charger port (Umi runtime)"
	depends on SPMI && POWER_SUPPLY && IIO && OF
	depends on THERMAL && THERMAL_OF
	help
	  SMB5 driver from colorgarden/umi-mainline with the fixed LOS Umi
	  current/voltage profile and automatic attach policy. The optional
	  bounded insertion command is diagnostic only.

config CHARGER_MISEED_UMI_PPS
	tristate "MiSeed Umi guarded BQ25970 PPS controller"
	depends on I2C && OF && TYPEC_TCPM && TYPEC_QCOM_PMIC
	depends on THERMAL && THERMAL_OF
	depends on CHARGER_MISEED_PM8150B && BATTERY_MISEED_QCOM_FG
	select REGMAP_I2C
	help
	  Automatic LOS-style PPS policy using mainline TCPM and a standalone
	  BQ25970. The Umi board profile is sink-only and is exercised on the
	  maintainer's Umi device through temporary RAM boot.

config MISEED_POWER_DIAGNOSTICS
	bool "MiSeed read-only wired SMB5 register diagnostics"
	depends on CHARGER_MISEED_PM8150B
	help
	  Log raw status registers from the owning charger's polling worker.
	  This is an optional diagnostic, not a product ABI or control path.
	  Normal consumers use power_supply attributes and notifications.

config MISEED_CHARGE_DIAGNOSTICS
	bool "MiSeed bounded wired charge diagnostic command"
	depends on CHARGER_MISEED_PM8150B
	help
	  Enable the temporary charge_test ABI only in diagnostic kernels.
	  Product consumers use power_supply charge_behaviour. No protection
	  is disabled by this option.
```
